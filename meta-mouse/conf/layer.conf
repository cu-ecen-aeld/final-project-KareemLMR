## meta-mouse/conf/layer.conf
```bitbake
# We have a conf and classes directory, add to BBPATH
BBPATH .= ":${LAYERDIR}"

# We have recipes-* directories, add to BBFILES
BBFILES += "${LAYERDIR}/recipes-*/*/*.bb \
            ${LAYERDIR}/recipes-*/*/*.bbappend"

BBFILE_COLLECTIONS += "meta-mouse"
BBFILE_PATTERN_meta-mouse = "^${LAYERDIR}/"
BBFILE_PRIORITY_meta-mouse = "6"

LAYERDEPENDS_meta-aesd = "core"
LAYERSERIES_COMPAT_meta-mouse = "hardknott kirkstone styhead scarthgap"
```
